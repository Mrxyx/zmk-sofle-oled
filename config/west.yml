## config/west.yml
```yaml
manifest:
  remotes:
    - name: zmkfirmware
      url-base: https://github.com/zmkfirmware
    - name: mctechnology17
      url-base: https://github.com/mctechnology17
    - name: eyelash
      url-base: https://github.com/a741725193
  projects:
    - name: zmk
      remote: zmkfirmware
      revision: v0.3.0
      import: app/west.yml
    - name: zmk-nice-oled
      url: https://github.com/Mrxyx/zmk-nice-oled.git
      revision: main
    - name: zmk-board-eyelash
      remote: eyelash
      revision: main
  self:
    path: config
```
